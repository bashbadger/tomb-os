## configs/tombos_defconfig
```kconfig
BR2_TOOLCHAIN_BUILDROOT=y
BR2_TOOLCHAIN_BUILDROOT_GCC=y
BR2_TOOLCHAIN_BUILDROOT_GCC_VERSION="13.x"
BR2_PACKAGE_GIT=y
BR2_PACKAGE_PYTHON3=y
BR2_PACKAGE_NODEJS=y
BR2_PACKAGE_OPENJDK=y
BR2_PACKAGE_CHROMIUM=y
BR2_PACKAGE_MYSQL_CLIENT=y
BR2_PACKAGE_POSTGRESQL=y
BR2_PACKAGE_REDIS=y
BR2_PACKAGE_SQLITE=y
# External packages will be added via overlay
BR2_TARGET_ROOTFS_EXT2_SIZE="8192"
# Compliance hardening
BR2_PACKAGE_OPENSSL=y
BR2_PACKAGE_LIBSELINUX=y
BR2_PACKAGE_AUDIT=y
BR2_PACKAGE_AUDITD=y
BR2_PACKAGE_NTP=y
BR2_TARGET_ROOTFS_ISO=y
```
